## ps/kernel/neptune_stream/Documentation/devicetree/bindings/misc/hamgeek,neptune-stream-dma-v1.yaml
```yaml
# SPDX-License-Identifier: GPL-2.0-only OR BSD-2-Clause
%YAML 1.2
---
$id: http://devicetree.org/schemas/misc/hamgeek,neptune-stream-dma-v1.yaml#
$schema: http://devicetree.org/meta-schemas/core.yaml#

title: HamGeek Neptune SDR PL-to-PS DMA stream

maintainers:
  - PhysicistJohn <54456354+PhysicistJohn@users.noreply.github.com>

description: |
  Receive-only PL stream endpoint implementing the canonical Neptune PL v1
  register map and mmap-slot metadata contract.  Linux allocates one 32-bit
  DMA-coherent ring and submits each slot through the DMAEngine receive channel
  named rx.  No private descriptor FIFO is overlaid on the PL register map.

  Presence of this node is a hardware assertion.  The driver also verifies the
  live identity, exact PL ABI version, capability bits, reset, fault interrupt,
  DMAEngine direction, DMA mask, and mmap support; a DT compatible alone is
  insufficient.

properties:
  compatible:
    const: hamgeek,neptune-stream-dma-v1

  reg:
    maxItems: 1

  interrupts:
    maxItems: 1

  interrupt-names:
    const: fault

  dmas:
    maxItems: 1

  dma-names:
    const: rx

  clocks:
    maxItems: 1

  resets:
    maxItems: 1
    description: Dedicated reset for the complete stream endpoint.

  ring-slots:
    $ref: /schemas/types.yaml#/definitions/uint32
    minimum: 4
    maximum: 256
    description: Number of fixed-size hardware slots.

  slot-bytes:
    $ref: /schemas/types.yaml#/definitions/uint32
    minimum: 4096
    maximum: 1048576
    multipleOf: 4096
    description: |
      Bytes per slot, including the 128-byte metadata header.  This binding is
      for 4 KiB-page Zynq systems; the driver additionally checks PAGE_SIZE.

required:
  - compatible
  - reg
  - interrupts
  - interrupt-names
  - dmas
  - dma-names
  - resets
  - ring-slots
  - slot-bytes

additionalProperties: false

examples:
  - |
    stream_dma: stream@7c480000 {
        compatible = "hamgeek,neptune-stream-dma-v1";
        reg = <0x7c480000 0x1000>;
        interrupt-parent = <&intc>;
        interrupts = <0 59 4>;
        interrupt-names = "fault";
        dmas = <&rx_dmac 0>;
        dma-names = "rx";
        clocks = <&clkc 15>;
        resets = <&stream_reset 0>;
        ring-slots = <64>;
        slot-bytes = <262144>;
    };
...
```

## ps/kernel/neptune_stream/Kconfig
```kconfig
# SPDX-License-Identifier: GPL-2.0-or-later OR MIT
config NEPTUNE_STREAM
	tristate "Neptune SDR PL DMA stream"
	depends on OF && HAS_DMA && DMA_ENGINE
	depends on ARCH_ZYNQ || COMPILE_TEST
	help
	  Own a DMA-coherent PL-to-PS receive ring for the Neptune SDR edge
	  data path using a DT-provided DMAEngine channel.  A single consumer
	  uses poll, fixed-width ioctls, and a read-only mmap to acquire and
	  release generation-tagged slots.  A separate nonexclusive read-only
	  status node exposes canonical PL health without mapping MMIO.

	  This driver does not use Linux IIO userspace reads for payloads.  It
	  binds only to a matching v1 PL register contract and fails probe for
	  unknown hardware, unsupported DMA mmap, or incomplete DT resources.

	  The source is deliberately limited to Linux 5.10 through 6.12.  The
	  repository's pinned Linux 4.14 development image is not supported.
```
